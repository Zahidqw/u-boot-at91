## board/atmel/ncx1_mk1/Kconfig
```kconfig
if TARGET_NCX1_MK1

config SYS_BOARD
	default "ncx1_mk1"

config SYS_VENDOR
	default "atmel"

config SYS_CONFIG_NAME
	default "ncx1_mk1"

endif
```

## board/atmel/nsx_mk1/Kconfig
```kconfig
if TARGET_NSX_MK1

config SYS_BOARD
	default "nsx_mk1"

config SYS_VENDOR
	default "atmel"

config SYS_CONFIG_NAME
	default "nsx_mk1"

endif
```
